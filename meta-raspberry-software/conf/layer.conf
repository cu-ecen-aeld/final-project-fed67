## meta-raspberry-software/conf/layer.conf
```bitbake
# We have a conf and classes directory, add to BBPATH
BBPATH .= ":${LAYERDIR}"
# We have recipes-* directories, add to BBFILES
BBFILES += "${LAYERDIR}/recipes-*/*/*.bb \
            ${LAYERDIR}/recipes-*/*/*.bbappend"
BBFILE_COLLECTIONS += "meta-raspberry-software"

# Define the pattern for your layer
BBFILE_PATTERN_meta-raspberry-software = "^${LAYERDIR}/"
# Set the priority of your layer
BBFILE_PRIORITY_meta-raspberry-software = "6"
# List the core layers you are compatible with
LAYERDEPENDS_meta-raspberry-software = "core"
LAYERSERIES_COMPAT_meta-raspberry-software = "scarthgap"

#REQUIRED_DISTRO_FEATURES = "systemd"
DISTRO_FEATURES:append = " systemd"
VIRTUAL-RUNTIME_init_manager ?= "systemd"
```
